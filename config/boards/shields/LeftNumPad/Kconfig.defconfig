## config/boards/shields/LeftNumPad/Kconfig.defconfig
```kconfig
# SPDX-License-Identifier: MIT

if SHIELD_NUMPAD5X6

config ZMK_KEYBOARD_NAME
    default "LeftNumPad"

endif
```

## config/boards/shields/LeftNumPad/Kconfig.shield
```kconfig
# SPDX-License-Identifier: MIT

config SHIELD_LeftNumPad
    def_bool $(shields_list_contains,LeftNumPad)
```
