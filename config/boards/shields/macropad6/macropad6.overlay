#include <dt-bindings/zmk/matrix_transform.h>
/ {
 chosen { zmk,kscan = &kscan0; zmk,matrix_transform = &default_transform; };
 default_transform: keymap_transform_0 {
  compatible = "zmk,matrix-transform"; rows = <3>; columns = <2>;
  map = <RC(0,0) RC(0,1) RC(1,0) RC(1,1) RC(2,0) RC(2,1)>;
 };
 kscan0: kscan_0 {
  compatible = "zmk,kscan-gpio-matrix"; wakeup-source;
  diode-direction = "col2row";
  col-gpios = <&gpio1 6 GPIO_ACTIVE_HIGH>, <&gpio1 4 GPIO_ACTIVE_HIGH>;
  row-gpios = <&gpio0 11 (GPIO_ACTIVE_HIGH | GPIO_PULL_DOWN)>,
              <&gpio1 0 (GPIO_ACTIVE_HIGH | GPIO_PULL_DOWN)>,
              <&gpio0 24 (GPIO_ACTIVE_HIGH | GPIO_PULL_DOWN)>;
 };
};
